## config/west.yml
```yaml
manifest:
  remotes:
    - name: myzmk
      url-base: https://github.com/tibiboard
  projects:
    - name: zmk
      remote: myzmk
      revision: mykbd-v1.0
      import: app/west.yml
  self:
    path: config
```
